## components/services/platform_esp/Kconfig
```kconfig
menu "Alarm platform"

    config ALARM_DEMO_ZONES
        bool "Create demo zones on first boot"
        default y
        help
            Adds eight simulator zones (doors, windows, motion, smoke, CO, water) to the
            factory configuration so the panel can be exercised from the serial console
            ("zone 1 open") before real sensors exist.

    config ALARM_ZSRC_SIM
        bool "Zone source: simulator"
        default y
        help
            Zones bound to the simulator are driven from the service console ("zone 3 open")
            instead of a sensor (docs/features/22). On the first start with zone sources, every
            existing zone is bound to it, since that is how zones were driven before.

    config ALARM_ZSRC_WIRED
        bool "Zone source: wired terminals"
        default y
        help
            Dry contacts between a terminal GPIO (the board's list, e.g. the CrowPanel's J7
            header) and GND, with the internal pull-up, sampled every 10 ms and debounced with
            each zone's response time (docs/features/22, ZONE-004). A pin is configured only once a
            zone is bound to it, or while the installer picks a terminal.

    config ALARM_ZSRC_HA
        bool "Zone source: Home Assistant entities"
        depends on ALARM_FEATURE_HA
        default y
        help
            Entities the paired Home Assistant shares (docs/features/23 M13, HAI-009) can feed
            zones: the integration's options pick what the panel may see, the zone editor
            searches that catalog, and state changes arrive over the paired TLS link
            (ha_link). Usable only while the integration is paired and connected; not
            trusted for fire, CO or 24-hour panic zones (docs/features/22 ZSRC-008).

    config ALARM_SERVICE_CONSOLE
        bool "Serial service console"
        default y
        help
            Status, zone simulator, virtual keypad and network settings on the debug UART.
            Turn off for release builds until the console asks for the installer code.

    config ALARM_CRYPTO_DIAGNOSTICS
        bool "Isolated crypto fault-injection test (development only)"
        depends on ALARM_SERVICE_CONSOLE
        default n
        help
            Adds crypto_test to the serial console. Runs on the alarm task with a test
            credential, injects a one-shot PSA allocation failure and checks recovery.
            Never verifies or changes a real user code. With BOARD_BACKLIGHT_FORCE_OFF,
            also adds ui_memory_test to walk unauthenticated UI pages. Disable in normal builds.

    config ALARM_TASK_PRIORITY
        int "Alarm task priority"
        range 2 22
        default 10

    config ALARM_EVENT_RING
        int "Recent events kept in RAM"
        range 16 1000
        default 100

endmenu
```

## components/services/rf_service/Kconfig
```kconfig
menu "Zone source: 433 MHz sensors (rf_service)"

    config ALARM_ZSRC_RF
        bool "Zone source: 433 MHz sensors (CC1101 or a receiver module)"
        default y
        help
            The cheap one-way 433 MHz door contacts, PIRs, water and smoke detectors and
            remotes that speak the EV1527 / PT2262 fixed code (docs/features/25), received by a
            TI CC1101 module wired to the wireless socket's SPI and one data pin, or by a
            fixed superheterodyne receiver module (RX470-4 / WL101-341, RXB6, SRX882: the
            Amazon "433 MHz transmitter and receiver" kits) on the data pin alone. Codes are
            learned by triggering the sensor in the zone editor. They send no heartbeat and
            can be replayed, so the source is not supervised and not trusted for fire, CO or
            24-hour panic zones by default (docs/features/22 ZSRC-008).

            Harmless without the module: the service asks the bus every 30 s and offers the
            source in the picker only while a receiver answers. `rf` on the console is the
            bench: status, `rf retry`, `rf freq <kHz>`, `rf module`, `rf raw on`, `rf capture <ms>`.

    if ALARM_ZSRC_RF
    config ALARM_RF_SPI_MOSI_GPIO
        int "CC1101 MOSI (SI) GPIO (-1: the board's wiring)"
        range -1 54
        default -1
        help
            -1 uses where the board description puts a receiver (board_info_t.rf): on the
            CrowPanel, the wireless-module socket's SPI - MOSI 6, MISO 7, SCK 8, CS on IO9 and
            the data line on IO10. Wire a CC1101 breakout there while the socket is empty, or
            anywhere else and set the pins here. The firmware checks the pins against the
            board at start-up and leaves the receiver off rather than use a flash pin, a pin
            the board already uses, or a strapping pin for the data line (GDO0 idles high on
            noise and would hold the strap through a reset).
    config ALARM_RF_SPI_MISO_GPIO
        int "CC1101 MISO (SO) GPIO (-1: the board's wiring)"
        range -1 54
        default -1
    config ALARM_RF_SPI_SCK_GPIO
        int "CC1101 SCK GPIO (-1: the board's wiring)"
        range -1 54
        default -1
    config ALARM_RF_SPI_CS_GPIO
        int "CC1101 CSn GPIO (-1: the board's wiring)"
        range -1 54
        default -1
    config ALARM_RF_GDO0_GPIO
        int "Data GPIO: the CC1101's GDO0, or a receiver module's DATA (-1: the board's)"
        range -1 54
        default -1
        help
            The demodulated line the RMT peripheral captures. A fixed receiver module (RX470-4,
            WL101-341, RXB6, SRX882) needs only this pin, 3V3 and GND - power it from 3V3, never
            5V: its DATA swings to its supply and the P4's pins are not 5 V tolerant.

    choice ALARM_RF_MODULE
        prompt "Receiver"
        default ALARM_RF_MODULE_AUTO
        help
            Which receiver this panel uses. `rf module auto|cc1101|ook` on the console
            overrides it and is remembered.
        config ALARM_RF_MODULE_AUTO
            bool "Automatic: a CC1101 if one answers, else a module on the data pin"
        config ALARM_RF_MODULE_CC1101
            bool "CC1101 only"
        config ALARM_RF_MODULE_OOK
            bool "Receiver module only (RX470-4, WL101-341, RXB6, SRX882)"
    endchoice
    config ALARM_RF_FREQ_KHZ
        int "Receive frequency, kHz"
        default 433920
        range 300000 464000
        help
            433920 for the cheap sensors and remotes; 315000 and 345000 for the American
            ones (345 MHz decoders come later). `rf freq` on the console
            overrides this and is remembered.
    config ALARM_RF_INVERT
        bool "The data line idles high"
        default n
        help
            A CC1101 in asynchronous mode idles low with the carrier off; some
            superheterodyne modules idle high. Set this when `rf capture` shows every frame
            upside down.
    endif

endmenu
```

## components/services/zigbee_service/Kconfig
```kconfig
menu "Zone source: Zigbee sensors (zigbee_service)"

    config ALARM_ZSRC_ZIGBEE
        bool "Zigbee sensors through the ESP32-H2 radio (bench: not yet accepted on hardware)"
        default n
        help
            Off-the-shelf Zigbee door and window contacts, motion, water, smoke, CO and panic
            sensors paired straight to the panel through the ESP32-H2 module in the CrowPanel's
            wireless socket (docs/features/20). They work with no Wi-Fi and no Home Assistant, are
            supervised by their own check-ins and report tamper and low battery, which is why
            this is the one radio source trusted for fire, CO and 24-hour panic zones by
            default (docs/features/22 ZSRC-008).

            The panel runs Espressif's Zigbee stack (esp-zigbee-lib) as coordinator and drives
            the H2, which runs firmware/radios/h2_rcp, over the socket's UART. On in every
            P4 image (firmware/crowpanel_p4/sdkconfig.defaults, ADR-047); bench acceptance is
            in docs/features/20. The stack keeps its network in the
            panel's NVS partition, in its own namespace; the partition table is unchanged.

    config ALARM_ZB_UART_BAUD
        int "UART baud rate to the ESP32-H2"
        depends on ALARM_ZSRC_ZIGBEE
        default 460800
        help
            Must match the H2's firmware (firmware/radios/h2_rcp, CONFIG_RCP_UART_BAUD).

    config ALARM_ZB_CHANNEL_MASK
        hex "Zigbee channels the network may form on"
        depends on ALARM_ZSRC_ZIGBEE
        default 0x02108800
        help
            Bit n set: channel n may be used. The default is 11, 15, 20 and 25 - the channels
            that fall between the usual Wi-Fi channels 1, 6 and 11, as Zigbee coordinators
            commonly prefer. The stack picks the quietest of them when it forms the network.

endmenu
```

## components/services/zwave_service/Kconfig
```kconfig
menu "Zone source: Z-Wave sensors (zwave_service)"

    config ALARM_ZSRC_ZWAVE
        bool "Zone source: Z-Wave sensors through a Zooz ZAC93"
        default n
        help
            Off-the-shelf Z-Wave door and window contacts, motion, water, smoke, CO and other
            sensors added straight to the panel through a Zooz ZAC93 module on a UART
            (docs/features/36): encrypted with Security 2, supervised by their check-ins, with
            tamper and low battery, working with no Wi-Fi and no Home Assistant. The panel runs
            its own Z-Wave host (components/core/zwave_host) and is its network's only
            controller.

            Needs PSRAM: the network's state is about 160 KB. The radio stays off until a place
            is chosen (`zwave place socket|j7` on the console, or the Flasher): until then no
            pin is touched. Every board's manifest states this option: the CrowPanel P4's turns
            it on (docs/features/36 Z9); a board without PSRAM leaves it off.

    if ALARM_ZSRC_ZWAVE
    config ALARM_ZWAVE_S0
        bool "Allow the older S0 security (phase 3, not built yet)"
        default n
        help
            Reserved for docs/features/36 phase 3 (security.md §10): devices that only speak S0.
            The host grants no S0 key in this firmware whatever this says.

    config ALARM_ZWAVE_LR
        bool "Z-Wave Long Range (phase 3, not built yet)"
        default n
        help
            Reserved for docs/features/36 phase 3 (network.md §13): 16-bit node IDs and the Long
            Range node list at start-up where the region has it. Off: classic Z-Wave only.

    config ALARM_ZWAVE_UART_NUM
        int "UART controller for the ZAC93"
        range 1 4
        default 3
        help
            UART0 is the service console and UART2 the ESP32-H2 sensor radio's
            (docs/features/20); the ZAC93 takes UART3 (docs/features/36 hardware.md §4).
    endif

endmenu
```

## components/ui/alarm_ui/Kconfig
```kconfig
menu "Touch UI (alarm_ui)"

    config ALARM_UI_LAYOUT
        string "Screen layout (components/ui/alarm_ui/layouts/<WxH>/alarm_ui)"
        default "1024x600"
        help
            Which LVGL Pro project the UI is built from: the folder layouts/<this>/alarm_ui. Each
            screen size has its own layout with the same subjects, object names and component
            signatures, so the UI logic is the same for all of them (ADR-036, docs/features/33). A
            board's manifest (firmware/<board>/sdkconfig.defaults) names its layout, and its PC
            simulator profile reads the same line.

    config ALARM_UI_LVGL_BUDGET_KB
        int "LVGL memory the board can spare for the UI (KB, 0 = not checked)"
        range 0 4096
        default 0
        help
            What the board can give LVGL for the touch UI at its busiest. The firmware doesn't
            use it: the PC preview measures the most the scripted walk ever needs (halved: the
            PC's pointers are twice as wide) and reports it against this budget, so a UI that
            outgrows its board shows on the PC first. 0 = not checked (boards with PSRAM).

endmenu
```

## firmware/c6_cp/sdkconfig.defaults
```kconfig
CONFIG_IDF_TARGET="esp32c6"
CONFIG_ESP_HOSTED=y
CONFIG_ESP_HOSTED_CP=y
CONFIG_ESP_HOSTED_CP_FOR_MCU=y
CONFIG_ESP_HOSTED_CP_RPC_V2=y
CONFIG_ESP_HOSTED_CP_FEAT_PEER_DATA=y
CONFIG_ESP_HOSTED_CP_WIFI_ENABLED=y
CONFIG_ESP_HOSTED_CP_FEAT_WIFI=y
CONFIG_EH_TRANSPORT_CP_SDIO=y
CONFIG_ESP_WIFI_ENABLED=y
CONFIG_BT_ENABLED=n
CONFIG_ESPTOOLPY_FLASHSIZE_4MB=y
CONFIG_PARTITION_TABLE_CUSTOM=y
CONFIG_PARTITION_TABLE_CUSTOM_FILENAME="partitions.csv"
CONFIG_FREERTOS_HZ=1000
CONFIG_COMPILER_OPTIMIZATION_SIZE=y
CONFIG_SECURE_SIGNED_APPS_NO_SECURE_BOOT=y
CONFIG_SECURE_SIGNED_ON_UPDATE_NO_SECURE_BOOT=y
CONFIG_SECURE_SIGNED_APPS_RSA_SCHEME=y
CONFIG_SECURE_BOOT_BUILD_SIGNED_BINARIES=y
CONFIG_SECURE_BOOT_SIGNING_KEY="../../secrets/ota_signing_key.pem"
```

## firmware/e32r40t/sdkconfig.defaults.release
```kconfig
CONFIG_ALARM_BUILD_RELEASE=y
# CONFIG_ALARM_BUILD_DEV is not set
# CONFIG_ALARM_SERVICE_CONSOLE is not set
# CONFIG_ALARM_CRYPTO_DIAGNOSTICS is not set
# CONFIG_HA_LINK_DIAGNOSTICS is not set
```
