## components/boards/crowpanel_p4_family/Kconfig
```kconfig
menu "CrowPanel Advanced P4 board"

    config BOARD_CROWPANEL_P4_ES8311
        bool
        help
            The board may carry an ES8311 codec on its sound lines (the 10.1in V1.2's
            schematic draws one): at start it is looked for at I2C0 0x18 and, where it
            answers, clocked from GPIO24 and set up. Where none answers the sound is plain
            I2S, as on the 7in, and GPIO24 is let go. Selected by the board component
            (board_crowpanel_10/Kconfig), never by hand.

    config BOARD_FLICKER_GUARD
        bool "Turn the backlight off when the display refresh stalls"
        default y
        help
            Photosensitivity safety. The display refresh is timed every frame; at the first
            late frame the backlight goes off, and it comes back only after the refresh has
            been steady for BOARD_FLICKER_GUARD_HOLD_S seconds. Keeps a stalling display from
            ever showing as a flashing screen.

    config BOARD_FLICKER_GUARD_HOLD_S
        int "Seconds of steady refresh before the backlight comes back"
        depends on BOARD_FLICKER_GUARD
        range 2 600
        default 10

    config BOARD_FRAME_CAPTURE
        bool "Let the app copy the screen (remote viewing and screenshots)"
        default y
        help
            Keeps track of which DSI frame buffer holds the last complete frame, so that
            board_dev_frame() can copy it for the Panel Manager's remote keypad and the
            developer screenshot (docs/features/30, /31). Costs one LVGL event per flush.

    config BOARD_BACKLIGHT_FORCE_OFF
        bool "Keep the backlight off (test builds)"
        default n
        help
            The display and UI run normally but the backlight never turns on. For testing
            display changes without anyone looking at the screen (console: "display").

    config BOARD_DISPLAY_DIAG
        bool "Display self-check (investigation builds)"
        default n
        help
            Compares every flush with the frame buffer and marks pixels no object paints
            (docs/bugs/B023); logs the chip temperature with the counts. Slows each redraw by
            a few milliseconds: for investigation builds only. Console: "dispdiag".

endmenu
```

## components/core/alarm_core/Kconfig
```kconfig
menu "Alarm core"

    config ALARM_MAX_PARTITIONS
        int "Maximum partitions"
        range 1 8
        default 4

    config ALARM_MAX_ZONES
        int "Maximum zones"
        range 1 999
        default 128 if IDF_TARGET_ESP32P4
        default 64

    config ALARM_MAX_USERS
        int "Maximum user codes (including installer and system master)"
        range 2 99
        default 64 if IDF_TARGET_ESP32P4
        default 32

    config ALARM_MAX_DEVICES
        int "Maximum supervised devices (keypads, expanders, radios)"
        range 1 32
        default 16

endmenu
```

## components/services/alarm_features/Kconfig
```kconfig
menu "Alarm features"
    # The feature menu every firmware shares (docs/features/33 step 6, the feature model). Each
    # board's sdkconfig.defaults states every option here explicitly: that file is the board's
    # manifest, read by its firmware build and by its PC simulator profile alike. An option
    # that is off compiles its component to nothing (see components/README.md) and the UI
    # hides what depended on it.

    menu "Build profile"
        config ALARM_BUILD_DEV
            bool "Explicit development profile"
            default n
            help
                Set by sdkconfig.defaults.dev (tools/idf.ps1 -Profile dev). The signed project
                name carries the profile, so a panel only accepts images of its own profile
                (docs/features/30).

        config ALARM_BUILD_RELEASE
            bool "Explicit release profile"
            default n
            help
                Set by sdkconfig.defaults.release. The firmware's CMakeLists refuses a release
                with developer or diagnostic access compiled in.
    endmenu

    config ALARM_FEATURE_UI
        bool "Touch UI on the panel's screen (alarm_ui + LVGL)"
        default y
        help
            Off for a headless build: the panel protects, reports and answers on the console
            without drawing (a board's first bring-up, or a panel with no screen). LVGL and the
            UI are then not linked (panel_app leaves the display alone).

    config ALARM_FEATURE_MQTT
        bool "MQTT integration (net_mqtt: TLS, Home Assistant discovery)"
        default y
        help
            One lasting TLS session. Fits every board so far.

    config ALARM_FEATURE_NOTIFY
        bool "Phone notifications (net_notify: ntfy, Pushover)"
        default y if SPIRAM
        default n
        help
            A short-lived TLS session per delivery, a configuration copy and a request
            buffer. On by default where PSRAM is; a board without it can turn it on once its
            RAM budget allows (docs/features/19).

    config ALARM_FEATURE_HA
        bool "Home Assistant native integration (ha_link, HACS)"
        default y if SPIRAM
        default n
        help
            A TLS server with 112 KB of link buffers: boards with PSRAM only.

    config ALARM_PANEL_WEB
        bool "Browser Panel Manager (panel_web, HTTPS)"
        default y if SPIRAM
        default n
        help
            The panel-hosted HTTPS configuration and full-resolution keypad (docs/features/31):
            up to three TLS sessions and a PSRAM frame for the remote screen.

    config ALARM_DEV_REMOTE
        bool "Developer access (dev_remote: network flashing, diagnostics, screen)"
        default y if SPIRAM
        default n
        help
            Enrolled workstations (docs/features/30). Controlled at run time from Installer >
            Remote access; the release profile keeps it (ADR-033).

    config ALARM_FEATURE_STORAGE
        bool "Storage: the microSD card and Settings > About > Storage (panel_storage)"
        default y
        help
            Mounting, checking and formatting a card on a worker task, and the flash accounting
            the Storage page shows (docs/features/29). Alarm configuration and the event log never
            live on the card. Off, panel_storage answers with stubs and the page is hidden.

    config ALARM_FEATURE_LANG_PACKS
        bool "Language packs: signed translations in the assets partition (lang_packs)"
        default y if SPIRAM
        default n
        help
            Every language but English is a signed pack file installed after the firmware into
            the assets partition and loaded into PSRAM when the panel speaks it (docs/features/37
            language-packs.md). Needs PSRAM and the assets partition; the firmware build makes
            the packs and signs them with the image's key. Off, the panel speaks English and the
            catalogs built into the image (ALARM_I18N_BUILTIN).

    config ALARM_FEATURE_VOICE
        bool "Voice: spoken zone names from a signed voice pack (panel_voice)"
        default y if SPIRAM
        default n
        help
            The installed voice pack (kind 2 in the assets partition, docs/features/08
            voice-first-build.md) is read into PSRAM at start-up and decoded on a worker with
            a 256 KiB PSRAM stack; speech is mixed into the sounder's output over the tones.
            Announcements stay off until a person switches them on. Needs PSRAM and the assets
            partition. Off, the panel sounds its tones only and voice packs can't be installed.

    config ALARM_I18N_BUILTIN
        bool "Translation catalogs built into the image"
        default n if ALARM_FEATURE_LANG_PACKS
        default y
        help
            Compiles the .po translations into the firmware as C tables (about 140 KB for each
            full language). Off where language packs carry the languages: the image holds only
            English, the source text.

    config ALARM_FEATURE_RTC
        bool "Battery-backed clock module (a DS3231 on the board's I2C connector)"
        default y
        help
            Looks for a DS3231 at start-up (docs/features/35). When one answers, it keeps the time
            through power cuts: the panel starts with the right time before the internet, and
            the time can be set by hand at the panel and in the Panel Manager. Without one
            nothing changes. A few KB of code, no RAM worth counting: on for every board whose
            description has an I2C connector (board_info()->i2c).

    config ALARM_FEATURE_AUTOMATIONS
        bool "Built-in automations (docs/features/41)"
        default y if SPIRAM
        default n
        depends on ALARM_HOME_CONTROL
        help
            Up to 16 rules the panel runs itself: one trigger (armed, disarmed, an alarm, a
            zone, a time of day) and one or two device actions from the Devices registry, or
            arming after a warning, or disarming as the person who saved it (AUT-011). Unlock,
            open and disarm only while the installer allows less secure automations (AUT-015).
            Stored in NVS (namespace "automations", at most 308 entries); about 15 KB of PSRAM.
            Needs the Devices registry (HCTL-010).

    config ALARM_LINK
        bool "Panel link: keypad panels for a master panel over Wi-Fi (plink_service)"
        default y if SPIRAM
        default n
        help
            Another panel can act as a keypad for this one, or this panel as a keypad for a
            master elsewhere in the house (docs/features/11): an encrypted UDP link on port
            6056, found by mDNS, paired with a code compared on both screens. The role is chosen
            once and stored (NVS "link"). The master keeps an encoded copy of its configuration
            for the keypads and a keypad a decoded one, about 100 KB of PSRAM. Off, the panel is
            a master without keypads and the UI shows nothing about them.

    config ALARM_FEATURE_PHOTO_SAVER
        bool "Photo screen saver (a JPEG decoded into a full-screen picture)"
        default y if SPIRAM
        default n
        help
            The picture takes width x height x 2 bytes of LVGL memory (1.2 MB at 1024x600).
            Without it the screen saver shows the clock and the state on a dark screen.

endmenu
```

## components/services/device_service/Kconfig
```kconfig
menu "Devices (device_service)"

    config ALARM_HOME_CONTROL
        bool "Devices screen: lights, locks, climate from the panel"
        default y
        depends on SPIRAM && (ALARM_FEATURE_HA || ALARM_ZSRC_ZWAVE)
        help
            The home_control registry (docs/features/24, HCTL-010): devices the paired Home
            Assistant allows for control, and the panel's own Z-Wave switches, dimmers and
            garage doors (docs/features/41 phase B), for automations; unlock and open ask for
            a user code first, checked by the engine. Needs PSRAM and a device source (Home
            Assistant or Z-Wave: Z-Wave alone needs no Home Assistant link); off for small
            boards.

endmenu
```

## components/services/ha_link/Kconfig
```kconfig
menu "Home Assistant link"
config HA_LINK_DIAGNOSTICS
    bool "Enable development-only trust-store fault injection"
    default n
    help
        Adds the serial-console command ha storefail on/off. It simulates a
        trust-store write failure without filling or corrupting NVS. Never
        enable this in a release image.
endmenu
```

## components/services/outputs_service/Kconfig
```kconfig
menu "Sirens and outputs (outputs_service)"

    config ALARM_OUTPUTS
        bool "Wired outputs and 433 MHz sirens"
        default y
        help
            The panel's own sirens and outputs (docs/features/16): a siren, a strobe, the smoke
            detectors' power or an "armed" light on a wired terminal through a relay or MOSFET
            module, and the cheap one-way 433 MHz sirens, which the panel transmits to (a
            CC1101, or a transmitter module set with `rf txpin`). Nothing is driven until an
            output is configured (`out` on the console, or Installer > Sirens and outputs), and
            a terminal an output takes is no longer offered to the wired zones.

endmenu
```

## components/services/panel_ota/Kconfig
```kconfig
menu "Firmware updates"

    config PANEL_OTA_DEVICE
        string "Device name the update server knows this board by (empty: the board's id)"
        default ""
        help
            The "device" a check sends to the update server (docs/features/13 OTA-018): the
            server's catalogue names a board by its product, for example "crowpanel_dhe04107d"
            for the CrowPanel Advanced 7" (set in its sdkconfig.defaults). Empty uses the board's
            id from its description (board_info()->id, for example "crowpanel_p4"), which backups
            use too and which stays as it is.

    config PANEL_OTA_DEFAULT_DOMAIN
        string "Update server (a domain)"
        default "roboalarms.com"
        help
            This build's own update server (OTA-017): the panel asks https://firmware.<domain>.
            The installer can choose another one (its signing key is then checked and confirmed,
            OTA-020); a panel with no choice stored, or a damaged one, uses this. Empty: no
            automatic checks until a server is chosen.

    config PANEL_OTA_CHECK_HOURS
        int "Check for updates every (hours)"
        range 0 720
        default 24
        help
            Only checks and shows what is available; installing always needs a person
            (panel, Home Assistant or console). 0 = check only on request.

    config PANEL_OTA_CP_AUTO
        bool "Update the Wi-Fi co-processor from the cp_fw partition automatically"
        default y
        help
            When the image in "cp_fw" differs from what the co-processor runs, send it once
            the system is idle (OTA-007). A failed attempt is not repeated automatically.

endmenu
```
